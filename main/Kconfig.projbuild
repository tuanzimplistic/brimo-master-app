## main/Kconfig.projbuild
```kconfig
menu "Itor3 master firmware configuration"

    #########################
    # MicroPython           #
    #########################
    menu "MicroPython"

        config MP_WEBREPL_AUTO_RUN
            bool "Run WebREPL automatically on bootup"
            default n
            help
                Automatically starts WebREPL when firmware starts

        config MP_WEBREPL_OVER_TLS
            bool "Use Websocket over TLS (wss) for WebREPL"
            default n
            help
                If yes, WebREPL must be accessed with wss theme (Websocket over TLS)
                If no, WebREPL is accessed with ws theme (plain Websocket over TCP)

    endmenu

    #########################
    # Over-The-Air update   #
    #########################
    menu "Over-The-Air firmware update"

        config OTA_NOTIFY_OVER_MQTT
            bool "Notify OTA progress and status over MQTT interface"
            default n
            help
                If turned on, OTA progress and status are notified over MQTT interface and LCD.
                If turned off, OTA progress and status are displayed on LCD only

    endmenu

    #########################
    # Test station build    #
    #########################
    menu "Test station build"

        config TEST_STATION_BUILD_ENABLED
            bool "Enable test station build"
            default n
            help
                This option indicates if this build is a special build for test station

        menu "WiFi access point for test station"

            config TEST_STATION_WIFI_SSID
                string "WiFi SSID"
                default "OQCZPLAP"
                help
                    WiFi SSID that the test station should connect to

            config TEST_STATION_WIFI_PASSWORD
                string "WiFi password"
                default "Zpl@1234!"
                help
                    Password of the WiFi access point that the test station should connect to

            config TEST_STATION_WIFI_RETRIES
                int "Number of retries connecting to the WiFi access point"
                range 3 255
                default 100
                help
                    Number of attempts that ESP32 tries to connect to the given WiFi access point.
                    Normally, one attempt takes approximately 2.5 seconds.
        endmenu

        menu "Static IP address of test station"

            config TEST_STATION_IP_ADDR
                string "IP address"
                default "192.168.1.2"
                help
                    Static IP address of test station (e.g, 192.168.1.2)

            config TEST_STATION_NETMASK
                string "Netmask"
                default "255.255.255.0"
                help
                    Netmask of test station (e.g, 255.255.255.0)

            config TEST_STATION_GATEWAY
                string "Default gateway"
                default "192.168.1.1"
                help
                    Default gateway address of test station (e.g, 192.168.1.1)

            config TEST_STATION_DNS
                string "DNS server"
                default "192.168.1.1"
                help
                    IP address of DNS server (e.g, 192.168.1.1)
        endmenu

    endmenu

endmenu
```

## platform/components/freemodbus/Kconfig.projbuild
```kconfig
# Kconfig file for Modbus component

menu "Modbus"

    config MODBUS_ENABLE
        bool "Enable Modbus component"
        default y
        help
            Enable or disable Modbus component

	choice
        prompt "UART physical layer"
        default MB_UART_PHY_MODE_RS485

        config MB_UART_PHY_MODE_RS232
            bool "UART RS232"
        config MB_UART_PHY_MODE_RS485
            bool "UART RS485"

    endchoice
    
    config UART_LOOPBAK_TEST_ENABLE
        bool "Enable UART loopback test"
        default y
    
    choice
        prompt "IDF version to use"
        default MODBUS_ZPL_IDF_V4_2

        config MODBUS_ZPL_IDF_V4_2
            bool "ESP-IDF v4.2"
        config MODBUS_ZPL_IDF_V4_0
            bool "ESP-IDF v4.0"

    endchoice

    config MODBUS_ZPL_ENABLE
        bool "Zimplistic Protocol Data Unit"
        default y

   menu "MAL Task"
        depends on MODBUS_ENABLE 
        config MAL_MB_TASK_CORE
            int "Pin this MAL to core (0: PRO, 1: APP, 2: NO AFFINITY)"
            range 0 2
            default 1
        config MAL_MB_TASK_PRIO
            int "Task Priority"
            default 21
        config MAL_MB_TASK_STACK
            int "Task Stack Size"
            default 2048
    endmenu #"MAL Task"

    config MODBUS_FUNC_HANDLERS_MAX
        depends on MODBUS_ENABLE
        int "Maximum Count of Request Handlers"
        range 16 127
        default 64

    config MODBUS_ZPL_MASTER
        depends on MODBUS_ENABLE
        bool "Enable Modbus master"
        default y
        help
            Enable or disable Modbus master mode
            
    menu "Master Configuration"
        depends on MODBUS_ZPL_MASTER
        
        config MB_UART_PORT_NUM
            int "UART port number"
            range 0 2
            default 2
            help
                UART communication port number for Modbus example.

        config MB_UART_BAUD_RATE
            int "UART communication speed"
            range 1200 460800
            default 115200
            help
                UART communication speed for Modbus example.

        config MB_UART_RXD
            int "UART RXD pin number"
            range 0 35
            default 35
            help
                GPIO number for UART RX pin. See UART documentation for more information
                about available pin numbers for UART.

        config MB_UART_TXD
            int "UART TXD pin number"
            range 0 35
            default 0
            help
                GPIO number for UART TX pin. See UART documentation for more information
                about available pin numbers for UART.

        config MB_UART_RTS
            depends on MB_UART_PHY_MODE_RS485   # RS232 doesn't need RTS
            int "UART RTS pin number"
            range 0 35
            default 4
            help
                GPIO number for UART RTS pin. This pin is connected to
                ~RE/DE pin of RS485 transceiver to switch direction.
                See UART documentation for more information about available pin
                numbers for UART.

        config FMB_MASTER_TIMEOUT_MS_RESPOND
            int "Slave respond timeout (Milliseconds)"
            default 150
            range 50 400
            help
                    If master sends a frame which is not broadcast, it has to wait sometime for slave response.
                    if slave is not respond in this time, the master will process timeout error.

        config FMB_MASTER_DELAY_MS_CONVERT
            int "Slave conversion delay (Milliseconds)"
            default 200
            range 50 400
            help
                    If master sends a broadcast frame, it has to wait conversion time to delay,
                    then master can send next frame.

        config FMB_QUEUE_LENGTH
            int "Modbus serial task queue length"
            range 0 200
            default 20
            help
                    Modbus serial driver queue length. It is used by event queue task.
                    See the serial driver API for more information.

        config FMB_SERIAL_TASK_STACK_SIZE
            int "Modbus serial task stack size"
            range 768 8192
            default 2048
            help
                    Modbus serial task stack size for event queue task.
                    It may be adjusted when debugging is enabled (for example).

        config FMB_SERIAL_BUF_SIZE
            int "Modbus serial task RX/TX buffer size"
            range 0 2048
            default 256
            help
                    Modbus serial task RX and TX buffer size for UART driver initialization.
                    This buffer is used for modbus frame transfer. The Modbus protocol maximum
                    frame size is 256 bytes. Bigger size can be used for non standard implementations.

        config FMB_SERIAL_TASK_PRIO
            int "Modbus serial task priority"
            range 3 25
            default 20
            help
                    Modbus UART driver event task priority.
                    The priority of Modbus controller task is equal to (CONFIG_FMB_SERIAL_TASK_PRIO - 1).

        config FMB_CONTROLLER_STACK_SIZE
            int "Modbus controller stack size"
            range 0 8192
            default 4096
            help
                    Modbus controller task stack size. The Stack size may be adjusted when
                    debug mode is used which requires more stack size (for example).

        config FMB_TIMER_GROUP
            int "Modbus Timer group number"
            range 0 1
            default 0
            help
                    Modbus Timer group number that is used for timeout measurement.

        config FMB_TIMER_INDEX
            int "Modbus Timer index in the group"
            range 0 1
            default 0
            help
                    Modbus Timer Index in the group that is used for timeout measurement.

        config FMB_TIMER_ISR_IN_IRAM
            bool "Place timer interrupt handler into IRAM"
            default y
            select UART_ISR_IN_IRAM
            help
                    This option places Modbus timer IRQ handler into IRAM.
                    This allows to avoid delays related to processing of non-IRAM-safe interrupts
                    during a flash write operation (NVS updating a value, or some other
                    flash API which has to perform an read/write operation and disable CPU cache).
                    This option has dependency with the UART_ISR_IN_IRAM option which places UART interrupt
                    handler into IRAM to prevent delays related to processing of UART events.

    endmenu # "Modbus Configuration"

endmenu
```

## platform/drivers/srvc_cam/Kconfig
```kconfig
menu "Camera configuration"
    config OV2640_SUPPORT
        bool "Support OV2640 2MP"
        default y
        help
            Enable this option if you want to use the OV2640.
            Disable this option to save memory.

    choice SCCB_HARDWARE_I2C_PORT
        bool "I2C peripheral to use for SCCB"
        default SCCB_HARDWARE_I2C_PORT1

        config SCCB_HARDWARE_I2C_PORT0
            bool "I2C0"
        config SCCB_HARDWARE_I2C_PORT1
            bool "I2C1"

    endchoice

    choice CAMERA_TASK_PINNED_TO_CORE
        bool "Camera task pinned to core"
        default CAMERA_CORE0
        help
            Pin the camera handle task to a certain core(0/1). It can also be done automatically choosing NO_AFFINITY.

        config CAMERA_CORE0
            bool "CORE0"
        config CAMERA_CORE1
            bool "CORE1"
        config CAMERA_NO_AFFINITY
            bool "NO_AFFINITY"

    endchoice

    config CAMERA_DMA_BUFFER_SIZE_MAX
        int "DMA buffer size"
        range 8192 32768
        default 32768
        help
            Maximum value of DMA buffer
            Larger values may fail to allocate due to insufficient contiguous memory blocks, and smaller value may cause DMA interrupt to be too frequent

endmenu
```

## platform/drivers/srvc_lcd_st7796s_demo/Kconfig
```kconfig
menu "LCD ST7796S"

    config LCD_SPI_HOST_DEV
        int "ESP32 SPI Host (1:HSPI, 2:VSPI)"
        range 1 2
        default 1
        help
            1 : HSPI (SPI2), 2 : VSPI (SPI3)

    config LCD_CLK_MHZ
        int "SPI Clock Frequency in MHz (divisors of 80MHz)"
        range 1 40
        default 40

    config LCD_CLK_IO_PIN
        int "LCD SPI Clock IO pin"
        range 0 39
        default 0

    config LCD_MOSI_IO_PIN
        int "LCD SPI MOSI IO pin"
        range 0 39
        default 4

    config LCD_SPI_MAX_TRANSFER_PIXELS
        int "Maximum number of pixels of one SPI transmission"
        range 2046 153600
        default 153600
        help
            Under the hood, SPI driver uses DMA to transfer display data from MCU to LCD controller.
            This config helps SPI driver allocate space for DMA descriptors at initialization.
            Transferring 4092 byte (2046 pixel) needs one DMA descriptor (three 32-bit words)
            As LVGL supports partial display updates, this config doesn't necessarily need to be equal to the LCD display size.

endmenu
```
